## u-boot-2019.01+gitAUTOINC+333c3e72d3-g333c3e72d3/board/flightcircuits/am335x-epn11291/Kconfig
```kconfig
if TARGET_EPN11291

config SYS_BOARD
	default "am335x-epn11291"

config SYS_VENDOR
	default "flightcircuits"

config SYS_SOC
	default "am33xx"

config SYS_CONFIG_NAME
	default "am335x_evm"

##source "board/ti/common/Kconfig"

endif
```

## u-boot-2019.01+gitAUTOINC+333c3e72d3-g333c3e72d3/configs/am335x_epn11291_defconfig
```kconfig
CONFIG_ARM=y
# added CONFIG_ARCH_CPU_INIT RWL not sure if it is needed
##########CONFIG_ARCH_CPU_INIT
CONFIG_ARCH_OMAP2PLUS=y
CONFIG_TI_COMMON_CMD_OPTIONS=y
CONFIG_AM33XX=y
CONFIG_SPL=y

CONFIG_BANNER_PRINT=y
# This section for debug serial port
CONFIG_DEBUG_UART_BOARD_INIT=y
CONFIG_DEBUG_UART_BASE=0x44e09000
CONFIG_DEBUG_UART_CLOCK=48000000
CONFIG_DEBUG_UART=y
CONFIG_DEBUG_UART_OMAP=y
# CONFIG_DEBUG_UART_NS16550=y
CONFIG_DEBUG_UART_SHIFT=2
CONFIG_DEBUG_UART_ANNOUNCE=y

CONFIG_DISTRO_DEFAULTS=y
CONFIG_SPL_LOAD_FIT=y
CONFIG_OF_BOARD_SETUP=y
CONFIG_OF_EMBED=n
CONFIG_OF_BOARD=n
CONFIG_OF_SEPARATE=y
CONFIG_BOOTCOMMAND="if test ${boot_fit} -eq 1; then run update_to_fit; fi; run findfdt; run init_console; run envboot; run distro_bootcmd"
CONFIG_LOGLEVEL=3
# CONFIG_SYS_CONSOLE_INFO_QUIET is not set
CONFIG_VERSION_VARIABLE=y
CONFIG_ARCH_MISC_INIT=y
CONFIG_SPL_FIT_IMAGE_TINY=y
CONFIG_SPL_ETH_SUPPORT=y
# CONFIG_SPL_EXT_SUPPORT is not set
##CONFIG_SPL_MTD_SUPPORT=y
##CONFIG_SPL_MUSB_NEW_SUPPORT=y
CONFIG_SPL_NET_SUPPORT=y
CONFIG_SPL_NET_VCI_STRING="EP11291 U-Boot SPL"
CONFIG_CMD_DHCP=y

CONFIG_SPL_OS_BOOT=y
##CONFIG_SPL_USB_GADGET=y
##CONFIG_SPL_USB_ETHER=y
CONFIG_CMD_SPL=y
CONFIG_CMD_MMC=y
CONFIG_CMD_BTRFS=n

##CONFIG_CMD_SPL_NAND_OFS=0x00080000
# CONFIG_CMD_FLASH is not set
##CONFIG_CMD_NAND=y
# CONFIG_CMD_SETEXPR is not set
##CONFIG_CMD_MTDPARTS=y
####CONFIG_MTDIDS_DEFAULT="nand0=nand.0"
CONFIG_MTDPARTS_DEFAULT="mtdparts=nand.0:128k(NAND.SPL),128k(NAND.SPL.backup1),128k(NAND.SPL.backup2),128k(NAND.SPL.backup3),256k(NAND.u-boot-spl-os),1m(NAND.u-boot),128k(NAND.u-boot-env),128k(NAND.u-boot-env.backup1),8m(NAND.kernel),-(NAND.file-system)"
# CONFIG_SPL_EFI_PARTITION is not set
CONFIG_OF_CONTROL=y
CONFIG_DEFAULT_DEVICE_TREE="am335x-epn11291"
CONFIG_OF_LIST="am335x-epn11291"
CONFIG_ENV_VARS_UBOOT_RUNTIME_CONFIG=y
CONFIG_SPL_ENV_IS_NOWHERE=y
CONFIG_BOOTCOUNT_LIMIT=y
CONFIG_DFU_MMC=n
CONFIG_DFU_NAND=n
CONFIG_DFU_RAM=n
CONFIG_USB_FUNCTION_FASTBOOT=n
CONFIG_DM_I2C=n
CONFIG_MISC=y
CONFIG_DM_MMC=y
# CONFIG_MMC_HW_PARTITIONING is not set
CONFIG_MMC_OMAP_HS=y
CONFIG_NAND=n
CONFIG_SPI_FLASH=n
CONFIG_SPI_FLASH_WINBOND=n
CONFIG_DM_ETH=y
CONFIG_MII=n
CONFIG_DRIVER_TI_CPSW=y
CONFIG_SPI=n
CONFIG_OMAP3_SPI=n
CONFIG_TIMER=y
CONFIG_OMAP_TIMER=y
CONFIG_USB=n
CONFIG_DM_USB=n
CONFIG_DM_USB_GADGET=n
CONFIG_SPL_DM_USB_GADGET=n
CONFIG_USB_MUSB_HOST=n
CONFIG_USB_MUSB_GADGET=n
CONFIG_USB_MUSB_TI=n
CONFIG_USB_MUSB_DSPS=n
CONFIG_USB_GADGET=n
##CONFIG_USB_GADGET_MANUFACTURER="Texas Instruments"
##CONFIG_USB_GADGET_VENDOR_NUM=0x0451
##CONFIG_USB_GADGET_PRODUCT_NUM=0xd022
##CONFIG_USB_ETHER=y
CONFIG_DYNAMIC_CRC_TABLE=y
CONFIG_RSA=y
CONFIG_LZO=y
CONFIG_CLK=y
CONFIG_CLK_CDCE9XX=y
```

## u-boot-2019.01+gitAUTOINC+333c3e72d3-g333c3e72d3/configs/epn11291_defconfig
```kconfig
CONFIG_ARM=y
# added CONFIG_ARCH_CPU_INIT RWL not sure if it is needed
CONFIG_ARCH_CPU_INIT=n
CONFIG_ARCH_OMAP2PLUS=y
CONFIG_TI_COMMON_CMD_OPTIONS=y
CONFIG_SPL_LIBCOMMON_SUPPORT=y
CONFIG_SPL_LIBGENERIC_SUPPORT=y
# CONFIG_ENV_OFFSET=0x0
CONFIG_AM33XX=y

CONFIG_SPL_MMC_SUPPORT=n
CONFIG_SPL_SERIAL_SUPPORT=n
CONFIG_SPL=y
CONFIG_BANNER_PRINT=y

# This section for debug serial port
CONFIG_DEBUG_UART_BOARD_INIT=y
CONFIG_DEBUG_UART_BASE=0x44e09000
CONFIG_DEBUG_UART_CLOCK=48000000
CONFIG_DEBUG_UART=y
CONFIG_DEBUG_UART_OMAP=y
# CONFIG_DEBUG_UART_NS16550=y
CONFIG_DEBUG_UART_SHIFT=2
CONFIG_DEBUG_UART_ANNOUNCE=y

CONFIG_SPL_ETH_SUPPORT=y
CONFIG_SPL_NET_SUPPORT=y
CONFIG_SPL_NET_VCI_STRING="EP11291 U-Boot SPL"

CONFIG_CMD_DHCP=y

CONFIG_SYS_VENDOR="flightcircuits"
CONFIG_SYS_BOARD="epn11291"
CONFIG_SYS_CONFIG_NAME="epn11291"
CONFIG_LOCALVERSION="-FlightCircuits-EPN11291"


CONFIG_OF_CONTROL=y
####CONFIG_SPL_BUILD=y
CONFIG_OF_EMBED=n
CONFIG_OF_BOARD=n
CONFIG_OF_SEPARATE=y
CONFIG_SPL_GPIO_SUPPORT=y

CONFIG_DISTRO_DEFAULTS=y
CONFIG_BOOTDELAY=2
CONFIG_BOOTCOMMAND="if test ${boot_fit} -eq 1; then run update_to_fit; fi; run findfdt; run init_console; run envboot; run distro_bootcmd"
CONFIG_CONSOLE_RECORD=n
CONFIG_SYS_CONSOLE_INFO_QUIET=n
CONFIG_DEFAULT_FDT_FILE="epn11291"
CONFIG_DEFAULT_DEVICE_TREE="epn11291"
CONFIG_VERSION_VARIABLE=y
CONFIG_ARCH_MISC_INIT=y

# I thinkg this is used to boot the OS right from SPL?
CONFIG_SPL_OS_BOOT=n
CONFIG_SPL_YMODEM_SUPPORT=y
CONFIG_DM_I2C=n
CONFIG_SYS_I2C_OMAP24XX=n
CONFIG_SPL_I2C_SUPPORT=n

CONFIG_AUTOBOOT_KEYED=n
CONFIG_AUTOBOOT_PROMPT="Press SPACE to abort autoboot in %d seconds\n"
## CONFIG_AUTOBOOT_DELAY_STR="d"
## CONFIG_AUTOBOOT_STOP_STR=" "
CONFIG_CMD_SPL=y
CONFIG_CMD_GPIO=n
CONFIG_CMD_GPT=n
CONFIG_CMD_MMC=y
CONFIG_CMD_BTRFS=n
CONFIG_CMD_CONFIG=y

CONFIG_MMC_OMAP_HS_ADMA=y
CONFIG_ENV_IS_IN_FAT=n
CONFIG_OF_LIST="epn11291"
CONFIG_ENV_IS_IN_EXT4=y
CONFIG_ENV_EXT4_INTERFACE="mmc"
CONFIG_ENV_EXT4_DEVICE_AND_PART="1:1"
CONFIG_ENV_EXT4_FILE="/boot/uboot.env"
CONFIG_ENV_VARS_UBOOT_RUNTIME_CONFIG=y
CONFIG_BOOTCOUNT_LIMIT=y
CONFIG_DFU_TFTP=n
CONFIG_DFU_MMC=n
CONFIG_DFU_RAM=n
### CONFIG_ENV_SIZE=0x20000
CONFIG_FASTBOOT_FLASH=n
### CONFIG_FASTBOOT_FLASH_MMC_DEV=1
CONFIG_FASTBOOT_CMD_OEM_FORMAT=n
CONFIG_RGMII=y
CONFIG_PHY_MARVELL=y
CONFIG_DRIVER_TI_CPSW=y
CONFIG_SPL_SERIAL_SUPPORT=y
CONFIG_TPL_SERIAL_PRESENT=n
CONFIG_DM_SERIAL=y
CONFIG_SPL_DM_SERIAL=y
CONFIG_DM_ETH=y
CONFIG_SPL_ETH_DEVICE="cpsw_emac0"
CONFIG_DM_MDIO=n
CONFIG_DM_MDIO_MUX=n
CONFIG_DM_MMC=y
CONFIG_SPL_DM_MMC=y
CONFIG_MMC_QUIRKS=y
CONFIG_OF_LIBFDT=y
CONFIG_SPL_LOG=y
CONFIG_SPL_LOGLEVEL=3

CONFIG_SPL_LOAD_FIT=y
CONFIG_OF_BOARD_SETUP=y

CONFIG_LOGLEVEL=3
CONFIG_SPL_FIT_IMAGE_TINY=y
CONFIG_SPL_EXT_SUPPORT=n
CONFIG_SPL_MTD_SUPPORT=n
CONFIG_SPL_MUSB_NEW_SUPPORT=n

CONFIG_SPL_USB_GADGET=n
CONFIG_SPL_USB_ETHER=n


##CONFIG_CMD_SPL_NAND_OFS=0x00080000
CONFIG_CMD_FLASH=n
CONFIG_CMD_NAND=n
CONFIG_SPL_NAND_SUPPORT=n
# CONFIG_CMD_SETEXPR is not set
CONFIG_CMD_MTDPARTS=n
##CONFIG_MTDIDS_DEFAULT="nand0=nand.0"
##CONFIG_MTDPARTS_DEFAULT="mtdparts=nand.0:128k(NAND.SPL),128k(NAND.SPL.backup1),128k(NAND.SPL.backup2),128k(NAND.SPL.backup3),256k(NAND.u-boot-spl-os),1m(NAND.u-boot),128k(NAND.u-boot-env),128k(NAND.u-boot-env.backup1),8m(NAND.kernel),-(NAND.file-system)"
CONFIG_SPL_EFI_PARTITION=n
CONFIG_SPL_ENV_IS_NOWHERE=y
CONFIG_DFU_MMC=n
CONFIG_DFU_NAND=n
CONFIG_DFU_RAM=n
CONFIG_USB_FUNCTION_FASTBOOT=n


CONFIG_MISC=y
# CONFIG_MMC_HW_PARTITIONING is not set
CONFIG_NAND=n
CONFIG_SPI_FLASH=n
CONFIG_SPI_FLASH_WINBOND=n
CONFIG_MII=n
CONFIG_SPI=n
CONFIG_OMAP3_SPI=n
CONFIG_TIMER=y
CONFIG_OMAP_TIMER=y
CONFIG_USB=n
CONFIG_DM_USB=n
CONFIG_DM_USB_GADGET=n
CONFIG_SPL_DM_USB_GADGET=n
CONFIG_USB_MUSB_HOST=n
CONFIG_USB_MUSB_GADGET=n
CONFIG_USB_MUSB_TI=n
CONFIG_USB_MUSB_DSPS=n
CONFIG_USB_GADGET=n
##CONFIG_USB_GADGET_MANUFACTURER="Texas Instruments"
##CONFIG_USB_GADGET_VENDOR_NUM=0x0451
##CONFIG_USB_GADGET_PRODUCT_NUM=0xd022
##CONFIG_USB_ETHER=y
CONFIG_DYNAMIC_CRC_TABLE=y
CONFIG_RSA=y
CONFIG_LZO=y
CONFIG_CLK=n
CONFIG_CLK_CDCE9XX=y
```
